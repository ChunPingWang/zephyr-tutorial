## CMakeLists.txt
```
cmake_minimum_required(VERSION 3.20.0)
find_package(Zephyr REQUIRED HINTS $ENV{ZEPHYR_BASE})
project(tutorial_esp32_wifi_shell)

target_sources(app PRIVATE src/main.c)
```

## prj.conf
```kconfig
# ===== Wi-Fi 驅動與管理層 =====
CONFIG_WIFI=y
CONFIG_NET_L2_WIFI_MGMT=y
CONFIG_NET_L2_WIFI_SHELL=y

# ===== 網路協定堆疊 =====
CONFIG_NETWORKING=y
CONFIG_NET_L2_ETHERNET=y
CONFIG_NET_IPV4=y
CONFIG_NET_DHCPV4=y
CONFIG_NET_UDP=y
CONFIG_NET_TCP=y

# ===== 網路管理事件 =====
CONFIG_NET_MGMT=y
CONFIG_NET_MGMT_EVENT=y
CONFIG_NET_MGMT_EVENT_INFO=y

# ===== Shell（互動式指令列）=====
CONFIG_SHELL=y
CONFIG_NET_SHELL=y
CONFIG_SHELL_STACK_SIZE=5200

# ===== 記憶體：Wi-Fi 驅動需要較大的堆疊與 heap =====
CONFIG_MAIN_STACK_SIZE=5200
CONFIG_NET_TX_STACK_SIZE=2048
CONFIG_NET_RX_STACK_SIZE=2048
CONFIG_HEAP_MEM_POOL_SIZE=98304

# ===== 日誌 =====
CONFIG_NET_LOG=y
CONFIG_LOG=y
CONFIG_WIFI_LOG_LEVEL_ERR=y

# 註：若與你的 Zephyr 版本不合（Kconfig 更名等），
# 請比對 zephyr/samples/net/wifi/shell 的 prj.conf 與其 ESP32 板子設定。
```

## src/main.c
```c
/*
 * ESP32 專屬課程 — Wi-Fi Shell：互動式掃描與連線
 *
 * 這一課不寫 Wi-Fi 程式碼，而是啟用 Zephyr 內建的 Wi-Fi shell，
 * 讓你用指令列互動操作 Wi-Fi——先把「流程」玩熟，之後要寫程式
 * 自動連線時（net_mgmt API），每個 API 都對應到這裡的一條指令。
 *
 * 常用指令（在序列埠終端機輸入）：
 *   wifi scan                        掃描附近的 AP
 *   wifi connect -s "SSID" -k 1 -p "密碼"   連線（-k 1 = WPA2-PSK）
 *   wifi status                      查看連線狀態
 *   wifi disconnect                  斷線
 *   net iface                        查看網路介面與取得的 IP
 *   net ping 8.8.8.8                 測試對外連線
 */
#include <zephyr/kernel.h>

int main(void)
{
	printk("\n=== ESP32 專屬課程：Wi-Fi Shell ===\n");
	printk("試試以下指令：\n");
	printk("  wifi scan\n");
	printk("  wifi connect -s \"你的SSID\" -k 1 -p \"你的密碼\"\n");
	printk("  wifi status\n");
	printk("  net iface\n");
	printk("  net ping 8.8.8.8\n\n");
	return 0;
}
```
